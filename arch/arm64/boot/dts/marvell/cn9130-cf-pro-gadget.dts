// SPDX-License-Identifier: GPL-2.0+
/*
 * Copyright (C) 2024 Josua Mayer <josua@solid-run.com>
 *
 * DTS for SolidRun CN9130 Clearfog Pro as USB Gadget on USB-A Connector.
 *
 */

#include "cn9130-cf-pro.dts"
#include "cn9130-cf-gadget.dtsi"

&cp0_usb3_1 {
	/* remove utmi phy */
	/delete-property/ phys;
	/delete-property/ phy-names;
	/* disable controller */
	status = "disabled";
};
